ENTRY(kernel_entry)
SECTIONS
{
    . = 0xa000; 
    .text :
    {
        *(.text)
    }
    .rodata :
    {
        *(.rodata)
    }
    .data :
    {
        *(.data)
    }
    .bss :
    {
        *(.bss)
    } 
}
